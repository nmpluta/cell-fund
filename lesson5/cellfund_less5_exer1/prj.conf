## prj.conf
```kconfig
#
# Copyright (c) 2019 Nordic Semiconductor ASA
#
# SPDX-License-Identifier: LicenseRef-Nordic-5-Clause
#

# Logging
CONFIG_LOG=y

# Button and LED support
CONFIG_DK_LIBRARY=y

# NewLib C
CONFIG_NEWLIB_LIBC=y

# Network
CONFIG_NETWORKING=y
CONFIG_NET_NATIVE=n
CONFIG_NET_SOCKETS=y
CONFIG_NET_SOCKETS_OFFLOAD=y
CONFIG_NET_SOCKETS_POSIX_NAMES=y

# Memory
CONFIG_HEAP_MEM_POOL_SIZE=4096
CONFIG_MAIN_STACK_SIZE=4096

# Modem library
CONFIG_NRF_MODEM_LIB=y
# CONFIG_NRF_MODEM_LIB_SYS_INIT is deprecated, and kept for compatibility with older NCS versions
CONFIG_NRF_MODEM_LIB_SYS_INIT=n

# LTE link control
CONFIG_LTE_LINK_CONTROL=y
# CONFIG_LTE_AUTO_INIT_AND_CONNECT is deprecated, and kept for compatibility with older NCS versions
CONFIG_LTE_AUTO_INIT_AND_CONNECT=n

# CoAP
# STEP 2.1 - Enable the CoAP library
CONFIG_COAP=y

# STEP 3.1 - Configure the CoAP server hostname
CONFIG_COAP_SERVER_HOSTNAME="californium.eclipseprojects.io"
CONFIG_COAP_SERVER_PORT=5683

# STEP 3.2 - Configure the CoAP resource for TX and RX communication
CONFIG_COAP_TX_RESOURCE="large-update"
CONFIG_COAP_RX_RESOURCE="validate"
```

## src/main.c
```c
/*
 * Copyright (c) 2019 Nordic Semiconductor ASA
 *
 * SPDX-License-Identifier: LicenseRef-Nordic-5-Clause
 */

#include <stdio.h>

#include <zephyr/kernel.h>
#include <zephyr/net/socket.h>
#include <zephyr/random/rand32.h>

#include <zephyr/logging/log.h>
#include <dk_buttons_and_leds.h>
#include <modem/nrf_modem_lib.h>
#include <modem/lte_lc.h>


/* STEP 2.2 - Include the header file for the CoAP library */
#include <zephyr/net/coap.h>

/* STEP 4.1 - Define the macro for the message from the board */
#define MESSAGE_TO_SEND "Hello from the nRF9160 DK!"

/* STEP 4.2 - Define the macros for the CoAP version and message length */
#define COAP_VERSION 1
#define MESSAGE_LEN  1280

/* STEP 5 - Declare the buffer coap_buf to receive the response. */
static uint8_t coap_buf[MESSAGE_LEN];

/* STEP 6.1 - Define the CoAP message token next_token */
static uint16_t next_token;

static int sock;
static struct sockaddr_storage server;

K_SEM_DEFINE(lte_connected, 0, 1);

LOG_MODULE_REGISTER(Lesson5_Exercise1, LOG_LEVEL_INF);

/**@brief Resolves the configured hostname. */
static int server_resolve(void)
{
	int err;
	struct addrinfo *result;
	struct addrinfo hints = {
		.ai_family = AF_INET,
		.ai_socktype = SOCK_DGRAM
	};
	char ipv4_addr[NET_IPV4_ADDR_LEN];

	err = getaddrinfo(CONFIG_COAP_SERVER_HOSTNAME, NULL, &hints, &result);
	if (err != 0) {
		LOG_ERR("ERROR: getaddrinfo failed %d\n", err);
		return -EIO;
	}

	if (result == NULL) {
		LOG_ERR("ERROR: Address not found\n");
		return -ENOENT;
	}

	/* IPv4 Address. */
	struct sockaddr_in *server4 = ((struct sockaddr_in *)&server);

	server4->sin_addr.s_addr =
		((struct sockaddr_in *)result->ai_addr)->sin_addr.s_addr;
	server4->sin_family = AF_INET;
	server4->sin_port = htons(CONFIG_COAP_SERVER_PORT);

	inet_ntop(AF_INET, &server4->sin_addr.s_addr, ipv4_addr,
		  sizeof(ipv4_addr));
	LOG_INF("IPv4 Address found %s\n", ipv4_addr);

	/* Free the address. */
	freeaddrinfo(result);

	return 0;
}

/**@brief Initialize the CoAP client */
static int client_init(void)
{
	int err;

	sock = socket(AF_INET, SOCK_DGRAM, IPPROTO_UDP);
	if (sock < 0) {
		LOG_ERR("Failed to create CoAP socket: %d.\n", errno);
		return -errno;
	}

	err = connect(sock, (struct sockaddr *)&server,
		      sizeof(struct sockaddr_in));
	if (err < 0) {
		LOG_ERR("Connect failed : %d\n", errno);
		return -errno;
	}

	LOG_INF("Successfully connected to server");

	/* STEP 6.2 - Generate a random token after the socket is connected */
	next_token = sys_rand32_get();

	return 0;
}

static void lte_handler(const struct lte_lc_evt *const evt)
{
     switch (evt->type) {
     case LTE_LC_EVT_NW_REG_STATUS:
        if ((evt->nw_reg_status != LTE_LC_NW_REG_REGISTERED_HOME) &&
            (evt->nw_reg_status != LTE_LC_NW_REG_REGISTERED_ROAMING)) {
            break;
        }
		LOG_INF("Network registration status: %s",
				evt->nw_reg_status == LTE_LC_NW_REG_REGISTERED_HOME ?
				"Connected - home network" : "Connected - roaming");
		k_sem_give(&lte_connected);
        break;
	case LTE_LC_EVT_RRC_UPDATE:
		LOG_INF("RRC mode: %s", evt->rrc_mode == LTE_LC_RRC_MODE_CONNECTED ?
				"Connected" : "Idle");
		break;
     default:
             break;
     }
}

static int modem_configure(void)
{
	int err;

	LOG_INF("Initializing modem library");

	err = nrf_modem_lib_init();
	if (err < 0) {
		LOG_ERR("Failed to initialize the modem library, error: %d", err);
		return err;
	}

	LOG_INF("Connecting to LTE network");

	err = lte_lc_init_and_connect_async(lte_handler);
	if (err < 0) {
		LOG_INF("Modem could not be configured, error: %d", err);
		return err;
	}

	k_sem_take(&lte_connected, K_FOREVER);
	LOG_INF("Connected to LTE network");
	dk_set_led_on(DK_LED2);

	return 0;
}

/**@biref Send CoAP GET request. */
static int client_get_send(void)
{
	int err;

	/* STEP 7.1 - Create the CoAP message*/
	struct coap_packet request;
	
	/* Increment the token for each request */
	next_token++;

	err = coap_packet_init(&request, coap_buf, sizeof(coap_buf),
						   COAP_VERSION, COAP_TYPE_NON_CON,
						   sizeof(next_token),
						   (uint8_t *)&next_token,
						   COAP_METHOD_GET, coap_next_id());
	if (err < 0) {
		LOG_ERR("Failed to initialize CoAP message, error: %d\n", err);
		return err;
	}

	/* STEP 7.2 - Add an option specifying the resource path */
	err = coap_packet_append_option(&request, COAP_OPTION_URI_PATH,
									(uint8_t *)CONFIG_COAP_RX_RESOURCE,
									strlen(CONFIG_COAP_RX_RESOURCE));
	if (err < 0) {
		LOG_ERR("Unable to add option %d, error: %d", COAP_OPTION_URI_PATH, err);
		return err;
	}

	/* STEP 7.3 - Send the configured CoAP packet */
	err = send(sock, request.data, request.offset, 0);
	if (err < 0) {
		LOG_ERR("Failed to send CoAP request, error: %d\n", err);
		return err;
	}

	LOG_INF("CoAP GET request sent: Token 0x%04x\n", next_token);

	return 0;
}

/**@biref Send CoAP PUT request. */
static int client_put_send(void)
{
	int err;
	struct coap_packet request;

	next_token++;

	/* STEP 8.1 - Initialize the CoAP packet and append the resource path */
	err = coap_packet_init(&request, coap_buf, sizeof(coap_buf),
						   COAP_VERSION, COAP_TYPE_NON_CON,
						   sizeof(next_token), (uint8_t *)&next_token,
						   COAP_METHOD_PUT, coap_next_id());
	if (err < 0) {
		LOG_ERR("Failed to initialize CoAP message, error: %d\n", err);
		return err;
	}

	/* Append the resource path. */
	err = coap_packet_append_option(&request, COAP_OPTION_URI_PATH,
									(uint8_t *)CONFIG_COAP_TX_RESOURCE,
									strlen(CONFIG_COAP_TX_RESOURCE));
	if (err < 0) {
		LOG_ERR("Unable to add option %d, error: %d", COAP_OPTION_CONTENT_FORMAT, err);
		return err;
	}

	/* STEP 8.2 - Append the content format as plain text */
	const uint8_t text_plain = COAP_CONTENT_FORMAT_TEXT_PLAIN;
	err = coap_packet_append_option(&request, COAP_OPTION_CONTENT_FORMAT,
									&text_plain,
									sizeof(text_plain));
	if (err < 0) {
		LOG_ERR("Unable to add option %d, error: %d", COAP_OPTION_CONTENT_FORMAT, err);
		return err;
	}

	/* STEP 8.3 - Add the payload to the message */
	err = coap_packet_append_payload_marker(&request);
	if (err < 0) {
		LOG_ERR("Unable to add payload marker, error: %d", err);
		return err;
	}

	err = coap_packet_append_payload(&request, (uint8_t *)MESSAGE_TO_SEND, sizeof(MESSAGE_TO_SEND));
	if (err < 0) {
		LOG_ERR("Unable to add payload, error: %d", err);
		return err;
	}

	err = send(sock, request.data, request.offset, 0);
	if (err < 0) {
		LOG_ERR("Failed to send CoAP request, %d\n", errno);
		return -errno;
	}

	LOG_INF("CoAP PUT request sent: Token 0x%04x\n", next_token);

	return 0;
}

/**@brief Handles responses from the remote CoAP server. */
static int client_handle_response(uint8_t *buf, int received)
{
	struct coap_packet reply;
	uint8_t token[8];
	uint16_t token_len;
	const uint8_t *payload;
	uint16_t payload_len;
	uint8_t temp_buf[128];
	int err;

	/* STEP 9.1 - Parse the received CoAP packet */
	err = coap_packet_parse(&reply, buf, received, NULL, 0);
	if (err < 0) {
		LOG_ERR("Invalid data received, error: %d\n", err);
		return err;
	}

	/* STEP 9.2 - Confirm the token in the response matches the token sent */
	token_len = coap_header_get_token(&reply, token);
	if ((token_len != sizeof(next_token)) ||
		(memcmp(&next_token, token, sizeof(next_token)) != 0))
	{
		LOG_ERR("Invalid token received 0x%02x%02x\n",
				token[1], token[0]);
		return -EINVAL;
	}
	else if (token_len == 0)
	{
		LOG_ERR("Token max length (COAP_TOKEN_MAX_LEN) is exceeded.");
		return -EINVAL;
	}

	/* STEP 9.3 - Retrieve the payload and confirm it's nonzero */
	payload = coap_packet_get_payload(&reply, &payload_len);

	if (payload_len > 0)
	{
		snprintf(temp_buf, MIN(payload_len + 1, sizeof(temp_buf)), "%s", payload);
		LOG_INF("CoAP response received: %s\n", (char *)temp_buf);
	}
	else
	{
		strcpy(temp_buf, "EMPTY");
	}

	/* STEP 9.4 - Log the header code, token and payload of the response */
	LOG_INF("CoAP response received: Code 0x%x, Token 0x%02x%02x, Payload %s\n",
			coap_header_get_code(&reply), token[0], token[1], (char *)temp_buf);

	return 0;
}

static void button_handler(uint32_t button_state, uint32_t has_changed)
{
	/* STEP 10 - Send a GET request or PUT request upon button triggers */
	if (has_changed & button_state & DK_BTN1_MSK) {
		LOG_INF("Button 1 pressed");
		LOG_INF("Sending CoAP GET request");
		client_get_send();
	}
	else if (has_changed & button_state & DK_BTN2_MSK) {
		LOG_INF("Button 2 pressed");
		LOG_INF("Sending CoAP PUT request");
		client_put_send();
	}
}

int main(void)
{
	int err;
	int received;

	if (dk_leds_init() != 0) {
		LOG_ERR("Failed to initialize the LED library");
	}

	err = modem_configure();
	if (err < 0) {
		LOG_ERR("Failed to configure the modem");
		return 0;
	}

	if (dk_buttons_init(button_handler) != 0) {
		LOG_ERR("Failed to initialize the buttons library");
	}

	if (server_resolve() != 0) {
		LOG_INF("Failed to resolve server name");
		return 0;
	}

	if (client_init() != 0) {
		LOG_INF("Failed to initialize client");
		return 0;
	}

	while (1)
	{
		/* STEP 11 - Receive response from the CoAP server */
		received = recv(sock, coap_buf, sizeof(coap_buf), 0);
		if (received < 0)
		{
			LOG_ERR("Failed to receive CoAP response");
			break;
		}
		else if (received == 0)
		{
			LOG_INF("Empty CoAP response received");
			continue;
		}

		/* STEP 12 - Parse the received CoAP packet */
		err = client_handle_response(coap_buf, received);
		if (err < 0)
		{
			LOG_ERR("Failed to handle CoAP response");
			break;
		}

	}

	(void)close(sock);

	return 0;
}
```
